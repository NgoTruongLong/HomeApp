## app/network/Kconfig.projbuild
```kconfig
menu "WiFi Configuration"

    config NETWORK_WIFI_SSID
        string "WiFi SSID"
        default "YOUR_WIFI_SSID"

    config NETWORK_WIFI_PASSWORD
        string "WiFi Password"
        default "YOUR_WIFI_PASSWORD"

    config NETWORK_WIFI_MAXIMUM_RETRY
        int "Maximum WiFi reconnection attempts"
        default 5
        range 0 20

endmenu
```

## app/network/time_control/Kconfig.projbuild
```kconfig
menu "Time Configuration"

    config NETWORK_SNTP_SERVER
        string "SNTP server address"
        default "pool.ntp.org"

endmenu
```
